#include "ssd1306.h"
#include <string.h>

// 5x7 字体，ASCII 32..127
static const uint8_t FONT5X7[] PROGMEM = {
    0x00,0x00,0x00,0x00,0x00, 0x00,0x00,0x5F,0x00,0x00, 0x00,0x07,0x00,0x07,0x00,
    0x14,0x7F,0x14,0x7F,0x14, 0x24,0x2A,0x7F,0x2A,0x12, 0x23,0x13,0x08,0x64,0x62,
    0x36,0x49,0x55,0x22,0x50, 0x00,0x05,0x03,0x00,0x00, 0x00,0x1C,0x22,0x41,0x00,
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    0x00,0x41,0x36,0x08,0x00, 0x08,0x04,0x08,0x10,0x08, 0x00,0x00,0x00,0x00,0x00,
};

bool SSD1306::cmd(uint8_t c) {
  wire_->beginTransmission(addr_);
  wire_->write(0x00);
  wire_->write(c);
  return wire_->endTransmission() == 0;
}

bool SSD1306::cmd2(uint8_t c0, uint8_t c1) {
  wire_->beginTransmission(addr_);
  wire_->write(0x00);
  wire_->write(c0);
  wire_->write(c1);
  return wire_->endTransmission() == 0;
}

bool SSD1306::data(const uint8_t *d, size_t n) {
  while (n) {
    size_t chunk = n > 16 ? 16 : n;
    wire_->beginTransmission(addr_);
    wire_->write(0x40);
    for (size_t i = 0; i < chunk; i++) wire_->write(d[i]);
    if (wire_->endTransmission() != 0) return false;
    d += chunk;
    n -= chunk;
  }
  return true;
}

bool SSD1306::begin(TwoWire &wire, uint8_t addr) {
  wire_ = &wire;
  addr_ = addr;
  delay(50);
  ok_ = cmd(0xAE);
  if (!ok_) return false;
  cmd(0xD5); cmd(0x80);
  cmd(0xA8); cmd(0x3F);
  cmd(0xD3); cmd(0x00);
  cmd(0x40);
  cmd(0x8D); cmd(0x14);
  cmd(0x20); cmd(0x00);
  cmd(0xA1);
  cmd(0xC8);
  cmd(0xDA); cmd(0x12);
  cmd(0x81); cmd(0xCF);
  cmd(0xD9); cmd(0xF1);
  cmd(0xDB); cmd(0x40);
  cmd(0xA4);
  cmd(0xA6);
  clear();
  show();
  cmd(0xAF);
  return true;
}

void SSD1306::clear() { memset(buf_, 0, sizeof(buf_)); }

void SSD1306::fill() { memset(buf_, 0xFF, sizeof(buf_)); }

void SSD1306::putChar(uint8_t col, uint8_t page, char c) {
  if (page > 7 || col > 122) return;
  if (c < 32 || c > 127) c = '?';
  const uint8_t *glyph = FONT5X7 + (c - 32) * 5;
  size_t base = (size_t)page * 128 + col;
  for (uint8_t i = 0; i < 5; i++) {
    buf_[base + i] = pgm_read_byte(glyph + i);
  }
  buf_[base + 5] = 0;
}

void SSD1306::drawText(uint8_t col, uint8_t page, const char *text) {
  while (*text && col < 122) {
    putChar(col, page, *text++);
    col += 6;
  }
}

void SSD1306::printfLines(const char *l0, const char *l1, const char *l2,
                          const char *l3) {
  clear();
  drawText(0, 0, l0);
  drawText(0, 2, l1);
  drawText(0, 4, l2);
  drawText(0, 6, l3);
  show();
}

void SSD1306::show() {
  cmd(0x21); cmd(0); cmd(127);
  cmd(0x22); cmd(0); cmd(7);
  data(buf_, sizeof(buf_));
}
