## firmware/sdkconfig.defaults
```kconfig
# Target: ESP32-S3-WROOM-1-N16R8 (16MB Flash + 8MB Octal PSRAM)
CONFIG_IDF_TARGET="esp32s3"

# DIO: N16R8 上 QIO 会使 bootloader 读分区表 magic 错成 0x10aa 并死循环
CONFIG_ESPTOOLPY_FLASHMODE_DIO=y
CONFIG_ESPTOOLPY_FLASHSIZE_16MB=y
CONFIG_ESPTOOLPY_FLASHSIZE="16MB"

# Octal PSRAM（大包/语音/录音需要）。语音默认关，由网页/API 开关，避免 AFE 启动断言拖垮整机。
CONFIG_SPIRAM=y
CONFIG_SPIRAM_MODE_OCT=y
CONFIG_SPIRAM_SPEED_40M=y
CONFIG_SPIRAM_IGNORE_NOTFOUND=y
# malloc() 只用内部 RAM；PSRAM 仅 heap_caps(MALLOC_CAP_SPIRAM)，减轻 tlsf 损坏
CONFIG_SPIRAM_USE_CAPS_ALLOC=y
# CONFIG_SPIRAM_USE_MALLOC is not set
CONFIG_SPIRAM_MALLOC_ALWAYSINTERNAL=4096
# memtest 偶发失败勿 abort（仍可能不稳定；语音请保持默认关）
# CONFIG_SPIRAM_MEMTEST is not set
# CONFIG_SPIRAM_TRY_ALLOCATE_WIFI_LWIP is not set

# 大包映射时 240M 易 BROWNOUT；先 160MHz
CONFIG_ESP_DEFAULT_CPU_FREQ_MHZ_160=y

CONFIG_PARTITION_TABLE_CUSTOM=y
CONFIG_PARTITION_TABLE_CUSTOM_FILENAME="partitions.csv"
CONFIG_PARTITION_TABLE_FILENAME="partitions.csv"

CONFIG_ESP_CONSOLE_UART_DEFAULT=y
CONFIG_ESP_CONSOLE_UART_BAUDRATE=115200

CONFIG_FREERTOS_HZ=1000

CONFIG_ESP_WIFI_STATIC_RX_BUFFER_NUM=10
CONFIG_ESP_WIFI_DYNAMIC_RX_BUFFER_NUM=32
CONFIG_ESP_WIFI_DYNAMIC_TX_BUFFER_NUM=32
CONFIG_LWIP_MAX_SOCKETS=16

CONFIG_COMPILER_OPTIMIZATION_SIZE=y

CONFIG_MODEL_IN_FLASH=y
CONFIG_SR_WN_WN9S_NIHAOXIAOZHI=y
CONFIG_SR_MN_CN_MULTINET6_QUANT=y
CONFIG_SR_NSN_WEBRTC=y
CONFIG_SR_VADN_WEBRTC=y
```

## firmware_recovery/sdkconfig.defaults
```kconfig
CONFIG_IDF_TARGET="esp32s3"
CONFIG_ESPTOOLPY_FLASHMODE_DIO=y
CONFIG_ESPTOOLPY_FLASHSIZE_16MB=y
CONFIG_ESPTOOLPY_FLASHSIZE="16MB"
# 救援不需要 PSRAM；本板 Octal PSRAM 自检偶发失败会导致无限重启
# CONFIG_SPIRAM is not set
CONFIG_ESP_DEFAULT_CPU_FREQ_MHZ_240=y
CONFIG_PARTITION_TABLE_CUSTOM=y
CONFIG_PARTITION_TABLE_CUSTOM_FILENAME="partitions.csv"
CONFIG_PARTITION_TABLE_FILENAME="partitions.csv"
CONFIG_ESP_CONSOLE_UART_DEFAULT=y
CONFIG_ESP_CONSOLE_UART_BAUDRATE=115200
CONFIG_COMPILER_OPTIMIZATION_SIZE=y
CONFIG_ESP_MAIN_TASK_STACK_SIZE=8192
CONFIG_ESP_WIFI_STATIC_RX_BUFFER_NUM=6
CONFIG_ESP_WIFI_DYNAMIC_RX_BUFFER_NUM=16
CONFIG_LWIP_MAX_SOCKETS=16
```
